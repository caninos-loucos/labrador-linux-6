## linux-source-6.1/arch/arm/mach-caninos/Kconfig
```kconfig
# SPDX-License-Identifier: GPL-2.0-only
config ARCH_CANINOS
	bool "Caninos Labrador"
	depends on ARCH_MULTI_V7
	select CACHE_L2X0
	select ARM_HAS_SG_CHAIN
	select ARM_PATCH_PHYS_VIRT
	select TIMER_OF
	select COMMON_CLK
	select GENERIC_CLOCKEVENTS
	select GENERIC_IRQ_MULTI_HANDLER
	select SPARSE_IRQ
	select USE_OF
	select MACH_CANINOS
	help
	  This enables support for the Caninos Labrador.

if ARCH_CANINOS

config MACH_CANINOS
	bool
	select ARM_AMBA
	select ARM_GIC
	select ARM_GLOBAL_TIMER
	select CLKSRC_ARM_GLOBAL_TIMER_SCHED_CLOCK
	select PM
	select GENERIC_IRQ_CHIP
	select HAVE_ARM_SCU
	select HAVE_ARM_TWD
	select HAVE_ARM_ARCH_TIMER
	select HAS_DMA
	select DMADEVICES
	select ARCH_REQUIRE_GPIOLIB
	select ARCH_HAS_OPP
	select ARCH_HAS_CPUFREQ
	select OF_ADDRESS
	select HIGHMEM
	select VFP
	select CANINOS_TIMER
	select RESET_CONTROLLER
	select CANINOS_PM_DOMAINS
	select DMA_CANINOS
	select PINCTRL
	select PINCTRL_CANINOS

endif
```

## linux-source-6.1/drivers/mfd/caninos/Kconfig
```kconfig
    
config MFD_CANINOS_PMIC
	bool "Caninos Labrador PMIC"
	select MFD_CORE
	select REGMAP_I2C
	select REGMAP_IRQ
	depends on I2C && OF
	help
	  Support for the Caninos Labrador PMIC.
	  This driver provides common support for accessing the device, additional 
	  drivers must be enabled in order to use the functionality of the device.

config MFD_CANINOS_AUXADC
	bool "Caninos Labrador PMICs Auxiliary ADC"
	depends on MFD_CANINOS_PMIC
	help
	  Support for reading the Caninos Labrador PMICs auxiliary ADC inputs.

config MFD_CANINOS_BATTERY
	bool "Caninos Labrador PMICs Battery Charging"
	depends on MFD_CANINOS_PMIC
	help
	  Support for Caninos Labrador PMICs battery charging.


config MFD_CANINOS_GPIO
	bool "Caninos Labrador PMICs GPIO"
	depends on MFD_CANINOS_PMIC
	help
	  Support for Caninos Labrador PMICs GPIO.
```

## linux-source-6.1/drivers/net/ethernet/caninos/Kconfig
```kconfig
# SPDX-License-Identifier: GPL-2.0

config CANINOS_K5_ETHERNET
	tristate "Caninos K5 Ethernet Media Access Controller"
	depends on ARM && (ARCH_CANINOS || COMPILE_TEST)
	default ARCH_CANINOS && ARM
	select PHYLIB
	help
	  This driver supports the Ethernet Media Access
	  Controller (EMAC) found on the K5 SBC.  The controller
	  is compliant with the IEEE 802.3 CSMA/CD standard and supports
	  both half-duplex and full-duplex operation modes at 10/100 Mb/s.
```

## linux-source-6.1/drivers/reset/caninos/Kconfig
```kconfig
config RESET_CANINOS
	bool "Caninos Labrador reset controller"
	depends on (ARCH_CANINOS || COMPILE_TEST)
	default ARCH_CANINOS
	select MFD_SYSCON
	help
	  This enables the reset controller driver for Caninos Labrador boards.
```

## linux-source-6.1/drivers/usb/caninos/Kconfig
```kconfig
config USB_CANINOS
	tristate "Caninos USB2.0 HCD support"
	depends on ARCH_CANINOS
	help
	  Enables support for Caninos Labrador SBCs USB2.0 host controller.

	  To compile this driver as a module, choose M here: the
	  module will be called caninoshcd.
```
